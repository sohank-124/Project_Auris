// =============================================================================
// File:        clk_gen.sv
// Project:     Project Auris
// Module:      clk_gen
// Description: Clock generation for the FPGA-only architecture.
//
//              Generates:
//                1. clk_dsp_o   — 96 MHz DSP clock (from MMCME2_BASE)
//                2. i2s_bclk_o  — 3.072 MHz I2S bit clock (fractional
//                                  divider from 96 MHz, exact ratio)
//                3. i2s_lrclk_o — 48 kHz I2S word select (÷64 from BCLK)
//
//              The 96 MHz clock is generated by the MMCME2_BASE primitive:
//                VCO = 12 MHz × 50 = 600 MHz
//                CLKOUT0 = 600 MHz / 6.25 = 96 MHz
//
//              The I2S BCLK is derived from the 96 MHz clock using a
//              fractional divide-by-31.25 counter.  This produces exactly
//              3.072 MHz with bounded period jitter (±10.4 ns max).
//              Codec jitter/PLL acceptance requires hardware measurement;
//              see docs/hardware/TIMING_CONTRACT.md for the STA model.
//
//              LRCLK is generated by dividing BCLK by 64, producing
//              exactly 48 kHz word select with 50% duty cycle.
//
//              The `locked` output is used as the system reset source.
//
//              Target:  Spartan-7 XC7S25-1CSGA324C (Arty S7-25)
//
// Author:      [generated]
// Created:     2026-07
// Modified:    2026-08 (FPGA-only migration: added BCLK/LRCLK generation)
// =============================================================================
`default_nettype none
`timescale 1ns / 1ps

module clk_gen (
    input  wire clk_in1,      // 12 MHz from onboard oscillator
    output wire clk_dsp_o,    // 96 MHz DSP clock
    output wire i2s_bclk_o,   // 3.072 MHz I2S bit clock
    output wire i2s_lrclk_o,  // 48 kHz I2S word select
    output wire locked        // MMCM lock indicator (high when locked)
);

    // -------------------------------------------------------------------------
    // Internal nets
    // -------------------------------------------------------------------------
    logic clk_fb;             // MMCM feedback
    logic clk_fb_bufg;        // BUFG-buffered feedback
    logic clk_dsp_raw;        // raw MMCM CLKOUT0
    logic mmcm_locked;        // MMCM LOCKED pin

    // I2S clock generation
    logic i2s_bclk_raw;       // BCLK before BUFG
    logic i2s_lrclk_raw;      // LRCLK before output FF

    // -------------------------------------------------------------------------
    // Global clock buffers
    // -------------------------------------------------------------------------
    BUFG bufg_fb (
        .I (clk_fb),
        .O (clk_fb_bufg)
    );

    BUFG bufg_dsp (
        .I (clk_dsp_raw),
        .O (clk_dsp_o)
    );

    // BUFG for I2S BCLK — distributes the generated bit clock with
    // minimal skew to both the internal I2S modules and the output pin.
    BUFG bufg_bclk (
        .I (i2s_bclk_raw),
        .O (i2s_bclk_o)
    );

    // LOCKED is asynchronous to the generated clocks. Synchronize release
    // separately for the rising-DSP and falling-BCLK state machines.
    wire rst_bclk_gen_n, rst_lrclk_gen_n;
    reset_release u_bclk_reset (
        .clk_i(clk_dsp_o), .async_rst_n_i(mmcm_locked),
        .rst_n_o(rst_bclk_gen_n)
    );
    reset_release #(.FALLING_EDGE(1'b1)) u_lrclk_reset (
        .clk_i(i2s_bclk_o), .async_rst_n_i(mmcm_locked),
        .rst_n_o(rst_lrclk_gen_n)
    );

    // -------------------------------------------------------------------------
    // MMCME2_BASE primitive
    // -------------------------------------------------------------------------
    // VCO = 12 MHz × 50 / 1 = 600 MHz (Spartan-7 MMCME2 minimum)
    // CLKOUT0 = 600 MHz / 6.25 = 96 MHz
    MMCME2_BASE #(
        .BANDWIDTH            ("OPTIMIZED"),
        .CLKFBOUT_MULT_F      (50.0),
        .CLKFBOUT_PHASE       (0.0),
        .CLKIN1_PERIOD        (83.333),
        .CLKOUT0_DIVIDE_F     (6.25),
        .CLKOUT0_DUTY_CYCLE   (0.5),
        .CLKOUT0_PHASE        (0.0),
        .CLKOUT1_DIVIDE       (1),
        .CLKOUT1_DUTY_CYCLE   (0.5),
        .CLKOUT1_PHASE        (0.0),
        .CLKOUT2_DIVIDE       (1),
        .CLKOUT2_DUTY_CYCLE   (0.5),
        .CLKOUT2_PHASE        (0.0),
        .CLKOUT3_DIVIDE       (1),
        .CLKOUT3_DUTY_CYCLE   (0.5),
        .CLKOUT3_PHASE        (0.0),
        .CLKOUT4_DIVIDE       (1),
        .CLKOUT4_DUTY_CYCLE   (0.5),
        .CLKOUT4_PHASE        (0.0),
        .CLKOUT5_DIVIDE       (1),
        .CLKOUT5_DUTY_CYCLE   (0.5),
        .CLKOUT5_PHASE        (0.0),
        .CLKOUT6_DIVIDE       (1),
        .CLKOUT6_DUTY_CYCLE   (0.5),
        .CLKOUT6_PHASE        (0.0),
        .DIVCLK_DIVIDE        (1),
        .REF_JITTER1          (0.010),
        .STARTUP_WAIT         ("FALSE")
    ) u_mmcm (
        .CLKIN1    (clk_in1),
        .CLKFBIN   (clk_fb_bufg),
        .CLKFBOUT  (clk_fb),
        .CLKOUT0   (clk_dsp_raw),
        .CLKOUT0B  (),
        .CLKOUT1   (),
        .CLKOUT1B  (),
        .CLKOUT2   (),
        .CLKOUT2B  (),
        .CLKOUT3   (),
        .CLKOUT3B  (),
        .CLKOUT4   (),
        .CLKOUT5   (),
        .CLKOUT6   (),
        .LOCKED    (mmcm_locked),
        .RST       (1'b0),
        .PWRDWN    (1'b0)
    );

    // -------------------------------------------------------------------------
    // I2S BCLK generation — fractional divide-by-31.25
    // -------------------------------------------------------------------------
    // 96 MHz / 31.25 = 3.072 MHz exactly.
    //
    // Eight transitions at 0,16,31,47,62,78,94,109 repeat every 125 clocks.
    // Half-periods are 15 or 16 clocks; rising periods are 31,31,32,31.
    // Four full cycles / 125 DSP clocks gives the exact average rate.
    // The XDC uses this ratio with uncertainty to bound unequal edge spacing.
    logic [6:0] bclk_cnt;  // 0..124

    always_ff @(posedge clk_dsp_o or negedge rst_bclk_gen_n) begin
        if (!rst_bclk_gen_n) begin
            bclk_cnt     <= 7'd0;
            i2s_bclk_raw <= 1'b0;
        end else begin
            if (bclk_cnt == 7'd124)
                bclk_cnt <= 7'd0;
            else
                bclk_cnt <= bclk_cnt + 7'd1;

            // Distribute eight toggles across the 125-cycle pattern.
            case (bclk_cnt)
                7'd0, 7'd16, 7'd31, 7'd47, 7'd62, 7'd78, 7'd94, 7'd109:
                    i2s_bclk_raw <= ~i2s_bclk_raw;
                default:
                    ; // hold
            endcase
        end
    end

    // -------------------------------------------------------------------------
    // I2S LRCLK generation — divide BCLK by 64
    // -------------------------------------------------------------------------
    // 3.072 MHz / 64 = 48 kHz.  32 BCLK cycles low, 32 BCLK cycles high.
    // We count BCLK edges and toggle LRCLK every 32 BCLK periods.
    // -------------------------------------------------------------------------
    logic [5:0] lrclk_cnt;   // 0..63

    always_ff @(negedge i2s_bclk_o or negedge rst_lrclk_gen_n) begin
        if (!rst_lrclk_gen_n) begin
            lrclk_cnt     <= 6'd0;
            i2s_lrclk_raw <= 1'b0;
        end else begin
            if (lrclk_cnt == 6'd63)
                lrclk_cnt <= 6'd0;
            else
                lrclk_cnt <= lrclk_cnt + 6'd1;

            if (lrclk_cnt == 6'd31)
                i2s_lrclk_raw <= 1'b1;   // transition to high (right channel)
            else if (lrclk_cnt == 6'd63)
                i2s_lrclk_raw <= 1'b0;   // transition to low (left channel)
        end
    end

    // LRCLK output — register for clean output
    // Use an ODDR-like approach or simple FF on BCLK
    // Simple registered output is sufficient for this frequency.
    assign i2s_lrclk_o = i2s_lrclk_raw;

    // -------------------------------------------------------------------------
    // Lock output
    // -------------------------------------------------------------------------
    assign locked = mmcm_locked;

endmodule : clk_gen

`default_nettype wire
