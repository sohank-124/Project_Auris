// =============================================================================
// File:        i2s_rx.sv
// Project:     Project Auris
// Module:      i2s_rx
// Description: I2S slave receiver targeting the INMP441 MEMS microphone in
//              **standard I2S (Philips)** mode.  In Philips I2S mode:
//
//                - LRCLK transitions one BCLK period *before* the MSB
//                - the MSB is clocked out on the SECOND BCLK rising edge
//                  after the LRCLK transition (1 BCLK after the WS change)
//                - 24 data bits are clocked MSB-first, no padding
//
//              The original implementation captured the MSB on the first
//              BCLK edge (left-justified behaviour), causing a 1-bit
//              shift corruption of every 24-bit sample.  The receiver
//              now waits 1 BCLK period after the LRCLK transition before
//              sampling sdata_i (ST_IDLE -> ST_WAIT -> ST_SHIFT_LEFT).
//
//              This module runs entirely in the bclk_i domain (3.072 MHz
//              generated by the FPGA).  Crossing into the 96 MHz
//              DSP domain is the responsibility of `cdc_i2s_to_dsp`.
//
// FSM (5 states, binary encoded):
//                 IDLE --> WAIT --> SHIFT_LEFT --> SHIFT_RIGHT --> VALID --> IDLE
//
// Author:      [generated]
// Created:     2026-07
// =============================================================================
`default_nettype none
`timescale 1ns / 1ps

module i2s_rx import auris_pkg::*; #(
    parameter int unsigned DATA_W = I2S_DATA_W   // 24 for INMP441
) (
    input  wire                bclk_i,      // bit clock (3.072 MHz)
    input  wire                lrclk_i,     // word clock: 0=left, 1=right
    input  wire                sdata_i,     // serial data from INMP441 SD
    input  wire                rst_n_i,
    output logic [DATA_W-1:0]  left_o,
    output logic [DATA_W-1:0]  right_o,
    output logic               valid_o,     // 1-BCLK-cycle strobe
    output logic               overflow_o   // sticky, cleared by host
);

    // LRCLK is synchronous to BCLK. The edge-detection cycle is the
    // I2S delay bit; capture begins on the following rising edge.
    logic lrclk_d, receiving, have_left;
    logic [4:0] bit_count;
    logic [DATA_W-1:0] shift_reg;
    always_ff @(posedge bclk_i or negedge rst_n_i) begin
        if (!rst_n_i) begin
            lrclk_d <= 0;
            receiving <= 0;
            have_left <= 0;
            bit_count <= 0;
            shift_reg <= 0;
            left_o <= 0;
            right_o <= 0;
            valid_o <= 0;
            overflow_o <= 0;
        end else begin
            lrclk_d <= lrclk_i;
            valid_o <= 0;
            if (lrclk_i != lrclk_d) begin
                if (receiving) overflow_o <= 1;
                receiving <= 1;
                bit_count <= 0;
                if (!lrclk_i) have_left <= 0;
            end else if (receiving) begin
                shift_reg <= {shift_reg[DATA_W-2:0], sdata_i};
                if (bit_count == DATA_W-1) begin
                    receiving <= 0;
                    if (!lrclk_i) begin
                        left_o <= {shift_reg[DATA_W-2:0], sdata_i};
                        have_left <= 1;
                    end else begin
                        right_o <= {shift_reg[DATA_W-2:0], sdata_i};
                        valid_o <= have_left;
                    end
                end else bit_count <= bit_count + 1'b1;
            end
        end
    end
    initial if (DATA_W < 8 || DATA_W > 24)
        $fatal(1, "i2s_rx DATA_W must be 8..24");
endmodule : i2s_rx
`default_nettype wire
